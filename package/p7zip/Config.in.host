## package/p7zip/Config.in.host
```kconfig
config BR2_PACKAGE_HOST_P7ZIP
	bool "host p7zip"
	help
	  p7zip is a quick port of the command line version of 7-zip
	  for Unix (see http://www.7-zip.org)

	  7-Zip is a file archiver with highest compression ratio.

	  https://github.com/p7zip-project/p7zip

if BR2_PACKAGE_HOST_P7ZIP

choice
	prompt "p7zip binary"
	default BR2_PACKAGE_HOST_P7ZIP_7ZR

config BR2_PACKAGE_HOST_P7ZIP_7ZA
	bool "7za"
	help
	  Full 7za archiver. The program supports 7z, ZIP, CAB, ARJ,
	  GZIP, BZIP2, TAR, CPIO, RPM and DEB formats

config BR2_PACKAGE_HOST_P7ZIP_7ZR
	bool "7zr"
	help
	  Lightweight 7zr archiver. The program only handles 7z archives
	  and cannot handle encrypted archives

endchoice

endif
```
